#include <behaviors.dtsi>
#include <dt-bindings/zmk/keys.h>

/  {
    keymap {
        compatible = "zmk,keymap";

        default_layer {
            bindings = <&kp SPACE &kp SPACE &kp G &kp C &kp B &kp X &kp I &kp Y &kp N7 &kp J &kp E &kp O &kp N8 &kp K &kp A &kp U &kp TAB &kp N5 &kp N3 &kp N1 &kp SPACE &kp N6 &kp N4 &kp N2 &kp ENTER &kp R &kp H &kp L &kp Z &kp M &kp T &kp D &kp F &kp S &kp W &kp P &kp N &kp V &kp Q &kp BACKSPACE>;
        };
    };
};